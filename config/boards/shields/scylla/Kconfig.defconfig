## config/boards/shields/scylla/Kconfig.defconfig
```kconfig
if SHIELD_SCYLLA_LEFT

    config ZMK_KEYBOARD_NAME
        default "scylla"

    config ZMK_SPLIT_BLE_ROLE_CENTRAL
        default y

endif

if SHIELD_SCYLLA_RIGHT

    config ZMK_KEYBOARD_NAME
        default "scylla r"

endif

if SHIELD_SCYLLA_LEFT || SHIELD_SCYLLA_RIGHT

    config ZMK_SPLIT
        default y

endif
```

## config/boards/shields/scylla/Kconfig.shield
```kconfig
config SHIELD_SCYLLA_LEFT
    def_bool $(shields_list_contains,SCYLLA_left)

config SHIELD_SCYLLA_RIGHT
    def_bool $(shields_list_contains,SCYLLA_right)
```
